## defconfig
```kconfig
BR2_arm=y
BR2_cortex_a7=y
BR2_TOOLCHAIN_EXTERNAL=y
BR2_TOOLCHAIN_EXTERNAL_LINARO_ARM=y
BR2_INIT_NONE=y
BR2_ROOTFS_DEVICE_CREATION_STATIC=y
# BR2_PACKAGE_BUSYBOX is not set
BR2_PACKAGE_LINUXPTP=y
```
